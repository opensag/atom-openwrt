## package/kernel/dta116x-devices/src/Kconfig
```kconfig
config DTA116X_DEVICES
        tristate "NEXSEC dta116x devices driver support"
        depends on GENERIC_GPIO
        help
          Say yes here to support NEXSEC dta116x devices driver
```

## package/kernel/gpio-cpld/src/Kconfig
```kconfig
config GPIO_CPLD
        tristate "NEXSEC CPLD GPIO support"
        depends on GENERIC_GPIO
        help
          Say yes here to support GPIO functionality of NEXSEC CPLD
```

## package/kernel/gpio-denverton/src/Kconfig
```kconfig
config GPIO_DENVERTON
        tristate "DENVERTON GPIO support"
        depends on GENERIC_GPIO
        help
          Say yes here to support denverton  GPIO function
```

## package/kernel/gpio-nct5523d/src/Kconfig
```kconfig
config GPIO_NCT5523D
        tristate "NCT5523D GPIO support"
        depends on GENERIC_GPIO
        help
          Say yes here to support GPIO functionality of NCT5523D super I/O chip
```

## package/wlan_wave_feed_6x/lq-wave-300_6x/config/Config.in
```kconfig
config FEATURE_LTQ_WAVE_500_PCIE_6x
	bool 'Enable WAVE500 real chip support'
	depends on PACKAGE_ltq-wlan-wave_6x
	default n
	help
	  Support for WAVE500 real chip (PCIE interface)

config FEATURE_LTQ_WAVE_500_6x
	bool 'Enable WAVE500 FPGA support'
	depends on PACKAGE_ltq-wlan-wave_6x
	default n
	help
	  Support for WAVE500 FPGA (AHB interface)

config FEATURE_LTQ_WAVE_AR10_SUPPORT_6x
	bool 'Enable WAVE support for AR10'
	depends on PACKAGE_ltq-wlan-wave_6x
	default n
	help
	  Support for WAVE on AR10 platforms

config FEATURE_LTQ_WAVE_STA_6x
	bool 'Enable WAVE station support'
	depends on PACKAGE_ltq-wlan-wave_6x
	default n
	help
	  Support for WAVE STA mode

config FEATURE_LTQ_WAVE_500B_6x
	depends on PACKAGE_ltq-wlan-wave_6x
	bool 'Enable WAVE500B'
	default n
	help
	  Support for WAVE500B and HAPS70

config FEATURE_LTQ_WAVE_600
	depends on PACKAGE_ltq-wlan-wave_6x
	bool 'Enable WAVE600 FPGA support'
	default n
	help
	  Support for WAVE600 FPGA

config FEATURE_LTQ_WAVE_CERT
	depends on PACKAGE_ltq-wlan-wave_6x
	bool 'Enable WAVE600 CERTIFICATION support'
	default n
	help
	  Support for WAVE600 CERTIFICATION

config FEATURE_WAVE_D2
	depends on PACKAGE_ltq-wlan-wave_6x
	bool 'Enable WAVE600 D2 support'
	default n
	help
	  Support for WAVE600 D2
```
